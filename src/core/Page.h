//
// Created by JanHe on 14.06.2025.
//

#ifndef PAGE_H
#define PAGE_H

#include <vector>
#include <Arduino.h>
#include "components/Component.h"

/**
 * @brief Represents a webpage with components and customizable content.
 *
 * The Page class is designed to construct an HTML-based webpage. It supports
 * adding components, setting a title, customizing the head section, and
 * rendering the complete HTML structure.
 */
class Page
{
private:
    std::vector<Component*> components;
    String title = "ESP32 Webpage";
    String extraHead; // Platz für zusätzliches CSS/JS

    /**
     * @brief Sets the title for the object.
     *
     * This method assigns the given title to the object's title attribute.
     *
     * @param t The title to be set.
     */
public:
    void setTitle(const String& t)
    {
        title = t;
    }

    /**
     * @brief Adds additional content to the extra head section.
     *
     * This method appends the provided content to the existing extra head data and ensures it is separated by a newline.
     *
     * @param headContent The content to be added to the extra head section.
     */
    void addExtraHead(const String& headContent)
    {
        extraHead += headContent + "\n";
    }

    /**
     * @brief Adds a component to the list of components.
     *
     * This method appends a new component to the internal collection of components
     * and returns the added component.
     *
     * @param c The component to be added.
     * @return A pointer to the component that was added.
     */
    Component* addComponent(Component* c)
    {
        components.push_back(c);

        return c;
    }

    /**
     * @brief Retrieves a component by its unique identifier.
     *
     * Searches through the list of components to find and return the component
     * that matches the specified identifier. If no matching component is found,
     * it returns a null pointer.
     *
     * @param id The unique identifier of the component to search for.
     * @return A pointer to the component with the specified ID, or nullptr if no
     *         matching component is found.
     */
    Component* getComponentById(const String& id)
    {
        for (auto comp : components)
        {
            if (comp->getId() == id)
            {
                return comp;
            }
        }
        return nullptr;
    }

    /**
     * @brief Generates the HTML content for the head section of a web page.
     *
     * This method creates a string representing the head section of an HTML document.
     * It includes the character encoding, viewport settings, title, and basic CSS styling.
     * Additional features, such as JavaScript or custom CSS, can be appended later by modifying this method.
     *
     * @return A string containing the HTML content for the head section.
     */
    String renderHead()
    {
        String head = "<meta charset=\"UTF-8\">\n";
        head += "<meta name=\"viewport\" content=\"width=device-width, initial-scale=1\">\n";
        head += "<title>" + title + "</title>\n";

        // Placeholder for custom CSS (not implemented).
        head += "<style>body { font-family: Arial, sans-serif; margin: 10px; }</style>\n";

        head += "<script src='/static/framework.js'></script>\n";

        // Todo: Add JS and other things to header.

        return head;
    }

    /**
     * @brief Renders the HTML representation of the object.
     *
     * This method constructs and returns a complete HTML document
     * by combining the head section, generated by renderHead,
     * and the body section which includes the HTML of all components.
     *
     * @return A string containing the generated HTML document.
     */
    String render()
    {
        String html = "<!DOCTYPE html>\n<html>\n<head>\n";
        html += renderHead();
        html += "</head>\n<body>\n";

        for (Component* c : components)
        {
            html += c->toHTML() + "\n";
        }

        html += "</body>\n</html>\n";
        return html;
    }
};

#endif
